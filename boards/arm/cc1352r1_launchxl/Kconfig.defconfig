## boards/arm/cc1352r1_launchxl/Kconfig.defconfig
```kconfig
# TI CC1352R LaunchXL board

# Copyright (c) 2019 Brett Witherspoon
# SPDX-License-Identifier: Apache-2.0

if BOARD_CC1352R1_LAUNCHXL

config BOARD
	default "cc1352r1_launchxl"

config BT_CTLR
	default BT

config BT_TI_LLL_PACKET_DEBUG
    bool "debug BT LLL packets"
    depends on BT
    default n

endif # BOARD_CC1352R1_LAUNCHXL
```
